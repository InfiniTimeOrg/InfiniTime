stock const symbol_batteryHalf{} = "\xEF\x89\x82"
stock const symbol_heartBeat{} = "\xEF\x88\x9E"
stock const symbol_bluetooth{} = "\xEF\x8A\x94"
stock const symbol_shieldAlt{} = "\xEF\x8F\xAD"
stock const symbol_plug{} = "\xEF\x87\xA6"
stock const symbol_shoe{} = "\xEF\x95\x8B"
stock const symbol_clock{} = "\xEF\x80\x97"
stock const symbol_bell{} = "\xEF\x83\xB3"
stock const symbol_info{} = "\xEF\x84\xA9"
stock const symbol_list{} = "\xEF\x80\xBA"
stock const symbol_sun{} = "\xEF\x86\x85"
stock const symbol_check{} = "\xEF\x95\xA0"
stock const symbol_music{} = "\xEF\x80\x81"
stock const symbol_tachometer{} = "\xEF\x8F\xBD"
stock const symbol_paintbrush{} = "\xEF\x87\xBC"
stock const symbol_paddle{} = "\xEF\x91\x9D"
stock const symbol_map{} = "\xEF\x96\xa0"
stock const symbol_phone{} = "\xEF\x82\x95"
stock const symbol_phoneSlash{} = "\xEF\x8F\x9D"
stock const symbol_volumMute{} = "\xEF\x9A\xA9"
stock const symbol_volumUp{} = "\xEF\x80\xA8"
stock const symbol_volumDown{} = "\xEF\x80\xA7"
stock const symbol_stepForward{} = "\xEF\x81\x91"
stock const symbol_stepBackward{} = "\xEF\x81\x88"
stock const symbol_play{} = "\xEF\x81\x8B"
stock const symbol_pause{} = "\xEF\x81\x8C"
stock const symbol_stop{} = "\xEF\x81\x8D"
stock const symbol_stopWatch{} = "\xEF\x8B\xB2"
stock const symbol_hourGlass{} = "\xEF\x89\x92"
stock const symbol_lapsFlag{} = "\xEF\x80\xA4"
stock const symbol_drum{} = "\xEF\x95\xA9"
stock const symbol_dice{} = "\xEF\x94\xA2"
stock const symbol_eye{} = "\xEF\x81\xAE"
stock const symbol_home{} = "\xEF\x80\x95"
stock const symbol_sleep{} = "\xEE\xBD\x84"
stock const symbol_calculator{} = "\xEF\x87\xAC"
stock const symbol_backspace{} = "\xEF\x95\x9A"
stock const symbol_cloudSun{} = "\xEF\x9B\x84"
stock const symbol_cloudSunRain{} = "\xEF\x9D\x83"
stock const symbol_cloudShowersHeavy{} = "\xEF\x9D\x80"
stock const symbol_smog{} = "\xEF\x9D\x9F"
stock const symbol_cloud{} = "\xEF\x83\x82"
stock const symbol_cloudMeatball{} = "\xEF\x9C\xBB"
stock const symbol_bolt{} = "\xEF\x83\xA7"
stock const symbol_snowflake{} = "\xEF\x8B\x9C"
stock const symbol_ban{} = "\xEF\x81\x9E"
stock const symbol_settings{} = "\xEE\xA2\xB8"
stock const symbol_brightnessLow{} = "\xEE\x8E\xAA"
stock const symbol_brightnessMedium{} = "\xEE\x8E\xAB"
stock const symbol_brightnessHigh{} = "\xEE\x8E\xAC"
stock const symbol_notificationsOff{} = "\xEE\x9F\xB6"
stock const symbol_notificationsOn{} = "\xEE\x9F\xB7"
stock const symbol_flashlight{} = "\xEF\x80\x8B"
stock const symbol_paintbrushLg{} = "\xEE\x90\x8A"
